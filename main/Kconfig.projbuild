## main/Kconfig.projbuild
```kconfig
menu "Boomstick Configuration"

    config BUTTON_REPEAT_DELAY
        int "Delay between resends in ms"
        default 200
        help
            Holding down a button sends mqtt messages every BUTTON_REPEAT_DELAY milliseconds.

endmenu
```
